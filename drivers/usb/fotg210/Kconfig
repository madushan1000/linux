## drivers/usb/fotg210/Kconfig
```kconfig
# SPDX-License-Identifier: GPL-2.0

config USB_FOTG210
	tristate "Faraday FOTG210 USB2 Dual Role controller"
	depends on USB || USB_GADGET
	depends on HAS_DMA && HAS_IOMEM
	depends on ARCH_GEMINI || SOC_BOUFFALOLAB || COMPILE_TEST
	default ARCH_GEMINI
	select MFD_SYSCON
	help
	  Faraday FOTG210 is a dual-mode USB controller that can act
	  in both host controller and peripheral controller mode.

if USB_FOTG210

config USB_FOTG210_HCD
	bool "Faraday FOTG210 USB Host Controller support"
	depends on USB=y || USB=USB_FOTG210
	help
	  Faraday FOTG210 is an OTG controller which can be configured as
	  an USB2.0 host. It is designed to meet USB2.0 EHCI specification
	  with minor modification.

	  To compile this driver as a module, choose M here: the
	  module will be called fotg210-hcd.

config USB_FOTG210_UDC
	depends on USB_GADGET=y || USB_GADGET=USB_FOTG210
	bool "Faraday FOTG210 USB Peripheral Controller support"
	help
	   Faraday USB2.0 OTG controller which can be configured as
	   high speed or full speed USB device. This driver supports
	   Bulk Transfer so far.

	   Say "y" to link the driver statically, or "m" to build a
	   dynamically linked module called "fotg210-udc".

config USB_FOTG210_UDC_V1_11_0
	bool "Support FOTG210 v1.11.0 and newer"
	default y if !MACH_A369
	depends on USB_FOTG210_UDC
	
config USB_FOTG210_UDC_V1_26_0
	bool "Support FOTG210 v1.26.0 and newer"
	select USB_FOTG210_UDC_V1_11_0
	depends on USB_FOTG210_UDC
	
config USB_FOTG210_UDC_DOUBLE_FIFO
	bool "Enable double FIFO support"
	depends on USB_FOTG210_UDC
	help
	   Faraday usb device controller work on Double FIFO.

config USB_FOTG210_UDC_VDMA
	bool "Enable VDMA support"
	depends on USB_FOTG210_UDC
	help
	   Faraday usb device controller work on VDMA.
	   This featrue supports after v1.20.0.

config USB_FOTG210_UDC_HALF_SPEED
	bool "Enable half speed support(For FPGA)"
	depends on USB_FOTG210_UDC
	help
	   Faraday usb device controller work on half speed.
	   When the system clock rate falls range of between 
	   15 MHz and 30 MHz, this needs to be enabled.

endif
```
